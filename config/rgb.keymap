&spi1 {
	compatible = "nordic,nrf-spim";
	status = "okay";
	mosi-pin = <31>;
	// Unused pins, needed for SPI definition, but not used by the ws2812 driver itself.
	sck-pin = <5>;
	miso-pin = <7>;

	led_strip: ws2812@0 {
		compatible = "worldsemi,ws2812-spi";
		label = "WS2812";

		/* SPI */
		reg = <0>; /* ignored, but necessary for SPI bindings */
		spi-max-frequency = <4000000>;

		/* WS2812 */
		chain-length = <8>; /* number of LEDs */
		spi-one-frame = <0x70>;
		spi-zero-frame = <0x40>;
	};
};
